## config/coreboot-novacustom-v560tu-acm.config_defconfig
```kconfig
CONFIG_LOCALVERSION="v1.0.1"
CONFIG_BOOTSPLASH_IMAGE=y
CONFIG_BOOTSPLASH_FILE="@BRAND_DIR@/bootsplash.jpg"
CONFIG_BOOTSPLASH_CONVERT=y
CONFIG_BOOTSPLASH_CONVERT_QUALITY=90
CONFIG_VENDOR_NOVACUSTOM=y
CONFIG_MAINBOARD_VENDOR="Clevo"
CONFIG_CBFS_SIZE=0x1000000
# CONFIG_CONSOLE_SERIAL is not set
# CONFIG_POST_IO is not set
# CONFIG_CONSOLE_POST is not set
CONFIG_FSP_FD_PATH="3rdparty/fsp/ArrowLakeFspBinPkg/IoT/ArrowLakeUH/Fsp.fd"
CONFIG_IFD_BIN_PATH="3rdparty/dasharo-blobs/novacustom/v5x0tu/descriptor.bin"
CONFIG_ME_BIN_PATH="3rdparty/dasharo-blobs/novacustom/v5x0tu/me.bin"
CONFIG_HAVE_IFD_BIN=y
CONFIG_BOARD_NOVACUSTOM_V560TU=y
CONFIG_TPM_MEASURED_BOOT=y
CONFIG_LINUX_COMMAND_LINE="quiet loglevel=2"
CONFIG_POWER_STATE_OFF_AFTER_FAILURE=y
CONFIG_FSP_HEADER_PATH="3rdparty/fsp/ArrowLakeFspBinPkg/IoT/ArrowLakeUH/Include"
CONFIG_SOFTWARE_CONNECTION_MANAGER=y
CONFIG_ENABLE_EARLY_DMA_PROTECTION=y
CONFIG_SOC_INTEL_COMMON_SPI_LOCKDOWN_SMM=y
CONFIG_VALIDATE_INTEL_DESCRIPTOR=y
# CONFIG_INTEL_CHIPSET_LOCKDOWN is not set
CONFIG_EC_DASHARO_EC_UPDATE=y
CONFIG_IFDTOOL_DISABLE_ME=y
CONFIG_HAVE_ME_BIN=y
CONFIG_INTEL_ME_DISABLED_HAP=y
CONFIG_BOOTSPLASH=y
# CONFIG_RESOURCE_ALLOCATION_TOP_DOWN is not set
CONFIG_ADD_FSP_BINARIES=y
CONFIG_FSP_FULL_FD=y
# CONFIG_USE_PC_CMOS_ALTCENTURY is not set
CONFIG_INTEL_TXT_BIOSACM_FILE="@BLOB_DIR@/novacustom_v5x0_mtl/MTL_BIOSAC_SIGNED.bin"
CONFIG_INTEL_CBNT_SUPPORT=y
CONFIG_INTEL_CBNT_LOGGING=y
# CONFIG_INTEL_CBNT_CBNT_PROV_KM_USE_CFG_FILE is not set
CONFIG_INTEL_CBNT_CBNT_PROV_CFG_FILE="@BLOB_DIR@/novacustom_v5x0_mtl/cbnt.json"
CONFIG_INTEL_CBNT_PROV_EXTERNAL_BIN=y
CONFIG_INTEL_CBNT_PROV_EXTERNAL_BIN_PATH="@BLOB_DIR@/novacustom_v5x0_mtl/cbnt-prov"
CONFIG_INTEL_CBNT_KM_PRIV_KEY_FILE="@BLOB_DIR@/novacustom_v5x0_mtl/.acm.keys/km_key.pem"
CONFIG_INTEL_CBNT_BPM_PRIV_KEY_FILE="@BLOB_DIR@/novacustom_v5x0_mtl/.acm.keys/bpm_key.pem"
CONFIG_INTEL_CBNT_KM_ID=0
CONFIG_BOOTMEDIA_LOCK_CONTROLLER=y
CONFIG_PAYLOAD_LINUX=y
CONFIG_PAYLOAD_FILE="@BOARD_BUILD_DIR@/bzImage"
CONFIG_LINUX_INITRD="@BOARD_BUILD_DIR@/initrd.cpio.xz"
```

## config/coreboot-starlabs_byte_cezanne.config_defconfig
```kconfig
CONFIG_USE_UEFI_VARIABLE_STORE=y
CONFIG_USE_AMD_BLOBS=y
CONFIG_SBOM=y
CONFIG_VENDOR_STARLABS=y
CONFIG_AMDFW_CONFIG_FILE="src/mainboard/starlabs/cezanne/fw.cfg"
CONFIG_BOARD_STARLABS_BYTE_CEZANNE=y
CONFIG_ADD_APCB_SOURCES=y
CONFIG_APCB_SOURCES_PATH="../amd_binaries/CZN/APCB/Byte-Y1"
CONFIG_EC_STARLABS_ADD_ITE_BIN=y
CONFIG_TPM_MEASURED_BOOT=y
CONFIG_FSP_M_FILE="../amd_binaries/FSP/CEZANNE_M.fd"
CONFIG_FSP_S_FILE="../amd_binaries/FSP/CEZANNE_S.fd"
CONFIG_RUN_FSP_GOP=y
CONFIG_SMMSTORE=y
CONFIG_MAINBOARD_SERIAL_NUMBER="Y100000"
CONFIG_PAYLOAD_LINUX=y
CONFIG_PAYLOAD_FILE="@BOARD_BUILD_DIR@/bzImage"
CONFIG_LINUX_INITRD="@BOARD_BUILD_DIR@/initrd.cpio.xz"
```

## config/coreboot-starlabs_lite_glkr.config_defconfig
```kconfig
CONFIG_USE_UEFI_VARIABLE_STORE=y
CONFIG_SBOM=y
CONFIG_VENDOR_STARLABS=y
# CONFIG_POST_IO is not set
CONFIG_BOARD_STARLABS_LITE_GLKR=y
CONFIG_TPM_MEASURED_BOOT=y
CONFIG_FSP_M_FILE="3rdparty/blobs/mainboard/starlabs/lite/glk/FSP/Release/Fsp_M.fd"
CONFIG_FSP_S_FILE="3rdparty/blobs/mainboard/starlabs/lite/glk/FSP/Release/Fsp_S.fd"
CONFIG_BOOT_PROFILE_2=y
CONFIG_SMMSTORE=y
CONFIG_ADD_FSP_BINARIES=y
CONFIG_MAINBOARD_SERIAL_NUMBER="I400000"
CONFIG_PAYLOAD_LINUX=y
CONFIG_PAYLOAD_FILE="@BOARD_BUILD_DIR@/bzImage"
CONFIG_LINUX_INITRD="@BOARD_BUILD_DIR@/initrd.cpio.xz"
```

## config/coreboot-starlabs_starbook_cezanne.config_defconfig
```kconfig
CONFIG_USE_UEFI_VARIABLE_STORE=y
CONFIG_USE_AMD_BLOBS=y
CONFIG_SBOM=y
CONFIG_VENDOR_STARLABS=y
# CONFIG_POST_IO is not set
CONFIG_AMDFW_CONFIG_FILE="src/mainboard/starlabs/cezanne/fw.cfg"
CONFIG_BOARD_STARLABS_STARBOOK_CEZANNE=y
CONFIG_ADD_APCB_SOURCES=y
CONFIG_APCB_SOURCES_PATH="../amd_binaries/CZN/APCB/Release"
CONFIG_TPM_MEASURED_BOOT=y
CONFIG_FSP_M_FILE="../amd_binaries/FSP/CEZANNE_M.fd"
CONFIG_FSP_S_FILE="../amd_binaries/FSP/CEZANNE_S.fd"
CONFIG_RUN_FSP_GOP=y
CONFIG_SMMSTORE=y
CONFIG_MAINBOARD_SERIAL_NUMBER="B6A0000"
CONFIG_PAYLOAD_LINUX=y
CONFIG_PAYLOAD_FILE="@BOARD_BUILD_DIR@/bzImage"
CONFIG_LINUX_INITRD="@BOARD_BUILD_DIR@/initrd.cpio.xz"
```
